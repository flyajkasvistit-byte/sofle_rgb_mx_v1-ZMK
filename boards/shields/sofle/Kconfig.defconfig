## boards/shields/sofle/Kconfig.shield
```kconfig
# Copyright (c) 2026 The ZMK Contributors
# SPDX-License-Identifier: MIT

config SHIELD_SOFLE_DONGLE
    def_bool $(shields_list_contains,sofle_dongle)
```
